/*
* Copyright (c) 2024 The ZMK Contributors
*
* SPDX-License-Identifier: MIT
*/

#include <dt-bindings/zmk/behaviors.h>

/ {
	behaviors {
		/omit-if-no-ref/ sm: sticky_modifiers {
			compatible = "zmk,behavior-sticky-modifiers";
			#binding-cells = <1>;
			display-name = "Sticky Modifiers";
		};
	};
};
