## dts/bindings/behaviors/zmk,behavior-sticky-modifiers.yaml
```yaml
# Copyright (c) 2024 The ZMK Contributors
# SPDX-License-Identifier: MIT

description: Sticky Modifiers behavior

compatible: "zmk,behavior-sticky-modifiers"

include: one_param.yaml
```
